#define TAPPING_TERM 280
#define QUICK_TAP_TERM 175


ht: hold_tap {
    label = "hold_tap";
    compatible = "zmk,behavior-hold-tap";
    #binding-cells = <2>;
    flavor = "balanced";
    tapping-term-ms = <TAPPING_TERM>;
    quick-tap-ms = <QUICK_TAP_TERM>;
    require-prior-idle-ms = <150>;
    hold-trigger-key-positions = <0 1 2 3 4 5 6 7 8 9 10 11 12 13 14 15 16 17 18 19 20 21 22 23 24 25 26 27 28 29 30 31 32 33 34 35 36 37 38 39 40 41>;
    hold-trigger-on-release;
    bindings = <&kp>, <&kp>;
};

mo_sl: behavior_mo_sl {
    label = "mo_sl";
    compatible = "zmk,behavior-hold-tap";
    #binding-cells = <2>;
    flavor = "hold-preferred";
    tapping-term-ms = <TAPPING_TERM>;
    quick-tap-ms = <QUICK_TAP_TERM>;
    bindings = <&mo>, <&sl>;
};