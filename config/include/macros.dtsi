macros {
    ubuntu_reboot: ubuntu_reboot {
        label = "macro_ubuntu_reboot";
        compatible = "zmk,behavior-macro";
        #binding-cells = <0>;
        wait-ms = <1000>;
        bindings
            = <&macro_press &kp LA(SYSREQ)>
            , <&macro_tap &kp R &kp E &kp I &kp S &kp U &kp B>
            , <&macro_pause_for_release>
            , <&macro_release &kp LA(SYSREQ)>
            ;
        };
};